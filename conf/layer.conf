## conf/layer.conf
```bitbake
# We have a conf and classes directory, append to BBPATH
BBPATH .= ":${LAYERDIR}"

# We have a recipes directory, add to BBFILES
BBFILES += "${LAYERDIR}/recipes*/*/*.bb ${LAYERDIR}/recipes*/*/*.bbappend ${LAYERDIR}/images/*.bb"

BBFILE_COLLECTIONS += "meta-xmrig"
BBFILE_PATTERN_meta-xmrig := "^${LAYERDIR}/"
BBFILE_PRIORITY_meta-xmrig = "100"

LAYERSERIES_COMPAT_meta-xmrig = "dunfell gatesgarth hardknott honister kirkstone langdale mickledore"

LAYERDEPENDS_meta-xmrig = "core"

LAYERRECOMMENDS_meta-xmrig = " \
    intel \
    raspberrypi \
"
```
